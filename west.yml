## west.yml
```yaml
# Equivalent to the above, but with manually maintained Zephyr modules.
manifest:
  # This is the west version that this manifest is compatible with.
  version: 1.2

  remotes:
    - name: zephyrproject-rtos
      url-base: https://github.com/zephyrproject-rtos

  defaults:
    remote: zephyrproject-rtos

  projects:
    - name: zephyr
      revision: main
      import:
        file: west.yml
        path-prefix: deps
        name-allowlist:
          - hal_stm32
          - nrf
          - hal_nordic
          - cmsis
          - cmsis_6
          - segger
          - mcuboot
          - mbedtls
          - zcbor
          - hal_nxp
          

  # Entries in the 'self' key are only applied to the _manifest repository_. 
  self:
    path: app 
```
